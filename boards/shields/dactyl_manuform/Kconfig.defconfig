## boards/shields/dactyl_manuform/Kconfig.defconfig
```kconfig
if SHIELD_DACTYL_MANUFORM_LEFT

    config ZMK_KEYBOARD_NAME
        default "DM-Left"

    config ZMK_SPLIT_BLE_ROLE_CENTRAL
        default y

endif

if SHIELD_DACTYL_MANUFORM_RIGHT

    config ZMK_KEYBOARD_NAME
        default "DM-Right"

endif

if SHIELD_DACTYL_MANUFORM_LEFT || SHIELD_DACTYL_MANUFORM_RIGHT

    config ZMK_SPLIT
        default y

endif
```
